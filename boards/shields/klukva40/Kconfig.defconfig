## boards/shields/klukva40/Kconfig.defconfig
```kconfig
if SHIELD_YOUR_KEYBOARD_TP_RIGHT

config ZMK_KEYBOARD_NAME
    default "Klukva 40"

config ZMK_SPLIT_ROLE_CENTRAL
    default y

endif
```

## boards/shields/klukva40/Kconfig.shield
```kconfig
config SHIELD_KLUKVA40_LEFT
    def_bool $(shields_list_contains,klukva40_left)

config SHIELD_KLUKVA40_RIGHT
    def_bool $(shields_list_contains,klukva40_right)
```

## config/west.yml
```yaml
manifest:
  remotes:
    - name: infused-kim
      url-base: https://github.com/infused-kim
    - name: petejohanson
      url-base: https://github.com/petejohanson
    - name: urob
      url-base: https://github.com/urob
    - name: badjeff
      url-base: https://github.com/badjeff
  projects:
    - name: zmk
      remote: infused-kim
      revision: pr-testing/mouse_ps2_module_base_urob
      import: app/west.yml
    #- name: zmk
    #  remote: urob
    #  revision: main
    #  import: app/west.yml
    - name: kb_zmk_ps2_mouse_trackpoint_driver
      remote: infused-kim
      revision: main
    - name: zmk-analog-input-driver
      remote: badjeff
      revision: main
  self:
    path: config
```
